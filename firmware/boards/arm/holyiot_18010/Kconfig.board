## firmware/boards/arm/holyiot_18010/Kconfig.board
```kconfig
# Holyiot YJ-18010 board configuration

config BOARD_HOLYIOT_18010
	bool "Holyiot YJ-18010 nRF52840 Module"
	depends on SOC_NRF52840_QIAA
	select HAS_NRFX
	select HAS_HW_NRF_GPIO0
	select HAS_HW_NRF_GPIO1
	select HAS_HW_NRF_GPIOTE
	select HAS_HW_NRF_RADIO_BLE_CODED
	select HAS_HW_NRF_RADIO_IEEE802154
```

## firmware/boards/arm/holyiot_18010/Kconfig.defconfig
```kconfig
# Holyiot YJ-18010 Kconfig defaults

if BOARD_HOLYIOT_18010

config BOARD
	default "holyiot_18010"

endif # BOARD_HOLYIOT_18010
```

## firmware/boards/arm/holyiot_18010/holyiot_18010_defconfig
```kconfig
# Holyiot YJ-18010 - nRF52840 Module
# Default configuration

CONFIG_SOC_SERIES_NRF52X=y
CONFIG_SOC_NRF52840_QIAA=y
CONFIG_BOARD_HOLYIOT_18010=y

# Enable MPU
CONFIG_ARM_MPU=y

# Enable hardware stack protection
CONFIG_HW_STACK_PROTECTION=y

# Enable GPIO
CONFIG_GPIO=y

# Clock configuration
CONFIG_CLOCK_CONTROL_NRF_K32SRC_RC=y
CONFIG_CLOCK_CONTROL_NRF_K32SRC_500PPM=y

# UART console (can disable for production)
CONFIG_SERIAL=y
CONFIG_CONSOLE=y
CONFIG_UART_CONSOLE=y
```
